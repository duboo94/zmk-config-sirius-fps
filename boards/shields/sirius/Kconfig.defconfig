## boards/shields/sirius/Kconfig.defconfig
```kconfig
if SHIELD_SIRIUS_LEFT

config ZMK_KEYBOARD_NAME
    default "SIRIUS FPS"

config ZMK_SPLIT_ROLE_CENTRAL
    default y

endif

if SHIELD_SIRIUS_LEFT || SHIELD_SIRIUS_RIGHT

config ZMK_SPLIT
    default y

endif
```

## boards/shields/sirius/Kconfig.shield
```kconfig
config SHIELD_SIRIUS_LEFT
    def_bool $(shields_list_contains,sirius_left)

config SHIELD_SIRIUS_RIGHT
    def_bool $(shields_list_contains,sirius_right)
```
